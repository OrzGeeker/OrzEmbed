## project/rust/sdkconfig.defaults
```kconfig
# Rust 相比 C 需要更大的主任务栈(默认 3K)
CONFIG_ESP_MAIN_TASK_STACK_SIZE=8192

# 适当增大默认偏小的栈
CONFIG_ESP_SYSTEM_EVENT_TASK_STACK_SIZE=4096
CONFIG_FREERTOS_IDLE_TASK_STACKSIZE=4096
CONFIG_PTHREAD_TASK_STACK_SIZE_DEFAULT=4096
```
